#include "stdint.h"
#include "fsl_i2c.h"
#define OLED_I2C_ADDR   0x3D

void OLED_ShowChar(unsigned char x, unsigned char y, unsigned char chr);
void OLED_Set_Pos(unsigned char x, unsigned char y);
const unsigned char F8X16[] =
{
  0x00,0x00,0x00,0x00,0x00,0x00,0x00,0x00,0x00,0x00,0x00,0x00,0x00,0x00,0x00,0x00,
  0x00,0x00,0x00,0xF8,0x00,0x00,0x00,0x00,0x00,0x00,0x00,0x33,0x30,0x00,0x00,0x00,
  0x00,0x10,0x0C,0x06,0x10,0x0C,0x06,0x00,0x00,0x00,0x00,0x00,0x00,0x00,0x00,0x00,
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  0x00,0x06,0x01,0x01,0x02,0x02,0x04,0x04,0x00,0x00,0x00,0x00,0x00,0x00,0x00,0x00,
};

void OLED_Set_Pos(unsigned char x, unsigned char y)
{
	uint8_t Set_Pos[6]={0x80,0x00,0x80,0x00,0x00,0x00};
	/*qm_spi_transfer_20151228(0,0xB0+y);
	qm_spi_transfer_20151228(0,((x&0xf0)>>4)|0x10);
	qm_spi_transfer_20151228(0,(x&0x0f));*/
	Set_Pos[1] = 0xB0+y;
	Set_Pos[3] = ((x&0xf0)>>4)|0x10;
	Set_Pos[5] = (x&0x0f);
	I2C_Write_polling(I2C0, OLED_I2C_ADDR, Set_Pos, 6);
}

void API_OLED_Clear(void)
{
	unsigned char i;
	uint8_t zero[256] = {0};

	for(i=0; i<253; i=i+2)
	{
		zero[i] = 0xC0;             /* command      */
		zero[i+1] = 0x00;             /* value = ' '  */
	}

	zero[254] = 0x40;                     /* End command  */

	for(i=0; i<8; i++)
	{
			OLED_Set_Pos(0, i);
			I2C_Write_polling(I2C0, OLED_I2C_ADDR, zero, 256);
	}
}

void OLED_init(void)
{

	/*  Variables */
	uint8_t OLED_Init_Reg[56]={0x80,0xAE,0x80,0x00,0x80,0x10,0x80,0x40,0x80,0x81,0x80,0xCF,0x80,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0x00,0xAF};

	/* OLED_Init_Reg */
	int size = sizeof(OLED_Init_Reg);
	I2C_Write_polling(I2C0, OLED_I2C_ADDR, OLED_Init_Reg, size);
  API_OLED_Clear();
}

void OLED_ShowChar(unsigned char x,unsigned char y,unsigned char chr)
{
    unsigned char c=0, i=0;
    uint8_t ShowChar[16];
    for(i=0; i<13; i=i+2)
		{
    	ShowChar[i] = 0xC0;
    }
/*
    ShowChar[0]=0xC0;
    ShowChar[2]=0xC0;
    ShowChar[4]=0xC0;
    ShowChar[6]=0xC0;
    ShowChar[8]=0xC0;
    ShowChar[10]=0xC0;
    ShowChar[12]=0xC0;
*/
    ShowChar[14] = 0x40;

    c = chr-' ';
    if(x>128-1)   
		{
			x = 0;
			y = y+2;
		}

    /* font , Line 1st  */
    OLED_Set_Pos(x, y);
    for(i=0; i<8; i++)
		{
      ShowChar[(2*i)+1] = F8X16[c*16+(i)];
    }
		I2C_Write_polling(I2C0, OLED_I2C_ADDR, ShowChar, 16);
		
    /* font , Line 2nd  */
    OLED_Set_Pos(x, y+1);
    for(i=0; i<8; i++)
		{
      ShowChar[(2*i)+1] = F8X16[c*16+(i)+8];
    }
		I2C_Write_polling(I2C0, OLED_I2C_ADDR, ShowChar, 16);
}

/* String length , Max = 16 */
void OLED_ShowStr(unsigned char x, unsigned char y, unsigned char *chr)
{
    unsigned char j;
    j = 0;
  
    while (chr[j] != '\0')
    {	
        if(x>120)
            break;
        
        OLED_ShowChar(x, y, chr[j]);
        x += 8;
        j++;
    }
}
